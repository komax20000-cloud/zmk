## app/dts/bindings/behaviors/zmk,behavior-key-repeat-delay.yaml
```yaml
# Copyright (c) 2026 The ZMK Contributors
# SPDX-License-Identifier: MIT

description: Set the initial key-repeat delay

compatible: "zmk,behavior-key-repeat-delay"

include: one_param.yaml
```

## app/dts/bindings/behaviors/zmk,behavior-key-repeat-pause.yaml
```yaml
# Copyright (c) 2026 The ZMK Contributors
# SPDX-License-Identifier: MIT

description: Pause firmware key repeat for five seconds

compatible: "zmk,behavior-key-repeat-pause"

include: zero_param.yaml
```

## app/dts/bindings/behaviors/zmk,behavior-key-repeat-rate.yaml
```yaml
# Copyright (c) 2026 The ZMK Contributors
# SPDX-License-Identifier: MIT

description: Adjust the firmware key-repeat interval

compatible: "zmk,behavior-key-repeat-rate"

include: one_param.yaml
```

## app/dts/bindings/behaviors/zmk,behavior-key-repeat-toggle.yaml
```yaml
# Copyright (c) 2026 The ZMK Contributors
# SPDX-License-Identifier: MIT

description: Enable or disable firmware key repeat

compatible: "zmk,behavior-key-repeat-toggle"

include: one_param.yaml
```
